#include "holi-sde-display.dtsi"


&dsi_sim_vid {
	qcom,panel-supply-entries = <&dsi_panel_pwr_supply>;
	qcom,mdss-dsi-bl-pmic-control-type = "bl_ctrl_dcs";
	qcom,platform-reset-gpio = <&pm6150l_gpios 9 0>;
};

//add p780 RM69299 LCD IC begin:
&dsi_rm69299_amoled_p780_cmd {
         qcom,panel-supply-entries = <&dsi_panel_pwr_supply>;
         qcom,mdss-dsi-bl-pmic-control-type = "bl_ctrl_dcs";
         qcom,mdss-dsi-bl-min-level = <1>;
         qcom,mdss-dsi-bl-max-level = <255>;
         qcom,platform-te-gpio = <&tlmm 23 0>;
         qcom,platform-reset-gpio = <&pm6150l_gpios 9 0>;
 };
//add p780 RM69299 LCD IC end

&sde_dsi {
	qcom,dsi-default-panel = <&dsi_rm69299_amoled_p780_cmd>;
};
