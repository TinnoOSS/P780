#ifndef RAMOOPS_DTSI
#define RAMOOPS_DTSI

&reserved_memory {

	qcom: ramoops {
		compatible = "ramoops";
		reg = <0x0 0xd0000000 0x0 0x200000>;
		record-size = <0x20000>;
		console-size = <0x20000>;
		pmsg-size = <0x20000>;
		mem-type = <2>;
	};
};

#endif