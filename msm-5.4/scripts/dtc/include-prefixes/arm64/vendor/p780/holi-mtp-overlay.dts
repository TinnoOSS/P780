/dts-v1/;
/plugin/;

#include "holi-mtp.dtsi"
/* PHIAAE-2: Add audio dts config overlay for p780*/
#include "holi-audio-p780-overlay.dtsi"

/* Tinno:CJ for journey dts config*/
#ifdef JOURNEY_FEATURE_SYSTEM_ENHANCED
#include "journey/long_press_reset.dtsi"
#endif

#ifdef JOURNEY_FEATURE_LOG_SYSTEM
#include "journey/ramoops.dtsi"
#endif

/ {
	model = "Qualcomm Technologies, Inc. Holi MTP";
	compatible = "qcom,holi-mtp", "qcom,holi", "qcom,mtp";
	qcom,msm-id = <454 0x10000>, <472 0x10000>;
	qcom,board-id = <8 0>;
};
